## CMakeLists.txt
```
cmake_minimum_required(VERSION 3.20.0)
find_package(Zephyr REQUIRED HINTS $ENV{ZEPHYR_BASE})

project(Motion2Midi_MidiDev)

target_sources(app PRIVATE src/main.c src/midiTx.c src/control.c src/BLE_central.c src/BLE_Simulator.c)
```

## prj.conf
```kconfig
CONFIG_BT=y
CONFIG_BT_CENTRAL=y
CONFIG_BT_DEVICE_NAME="nRF7002-DK"
CONFIG_BT_GATT_CLIENT=y

#Konfiguration for UART MIDI transmission med async API
CONFIG_UART_ASYNC_API=y
```

## boards/nrf7002dk_nrf5340_cpuapp.overlay
```dts
&uart1 {
    status = "okay";
    current-speed = <31250>;
};

&gpio_fwd {
    status = "disabled";
};

&i2c1 {
    status = "disabled";
};
```

## src/main.c
```c
#include "control.h"
#include "gestureEvent.h"
#include "midiEvent.h"
#include <zephyr/kernel.h>

#include "BLE_central.h"
#include "BLE_Simulator.h"

#define MIDI_TX_STACK_SIZE 4096
#define MIDI_TX_PRIORITY 1
#define CONTROL_STACK_SIZE 1024
#define CONTROL_PRIORITY 7
#define BLE_STACK_SIZE 2048
#define BLE_PRIORITY 7

// Static queue creation
K_MSGQ_DEFINE(midi_q, sizeof(midiEvent), 10, 4);

K_MSGQ_DEFINE(control_q, sizeof(gestureEvent), 10, 4);

// Static thread creation
K_THREAD_DEFINE(midiTxThread, MIDI_TX_STACK_SIZE, MidiTransmitThreadFunct,
                &midi_q, NULL, NULL, MIDI_TX_PRIORITY, 0, 0);

K_THREAD_DEFINE(controlThread, CONTROL_STACK_SIZE, ControlThreadFunct, &midi_q,
                &control_q, NULL, CONTROL_PRIORITY, 0, 0);

K_THREAD_DEFINE(bleThread, BLE_STACK_SIZE, BLE_ThreadFunct, &control_q, NULL,
  NULL, BLE_PRIORITY, 0, 0);
//K_THREAD_DEFINE(bleSimulationThread, BLE_STACK_SIZE, BLE_Simulator_ThreadFunct,
//                &control_q, NULL, NULL, BLE_PRIORITY, 0, 0);

int main(void) { return 0; }
```

## src/BLE_Simulator.c
```c
#include "BLE_Simulator.h"
#include "gestureEvent.h"

void BLE_Simulator_ThreadFunct(void *control_q_ptr, void *p2, void *p3) {
  (void)p2;
  (void)p3;
  struct k_msgq *control_q = (struct k_msgq *)control_q_ptr;
  int counter = 0; // Simuleret tæller for at generere forskellige hændelser
  int gesture[16] = {0, 4, 1, 4, 2, 4, 3, 4,
                     5, 4, 6, 4, 7, 4, 8, 4}; // Simuleret gestureEvent værdier
  while (1) {

    gestureEvent event =
        gesture[counter]; // Simuleret gestureEvent, du kan ændre dette for at
                          // teste forskellige hændelser
    k_msgq_put(control_q, &event, K_NO_WAIT);
    k_sleep(K_SECONDS(1)); // Simulerer en forsinkelse mellem hændelser
    counter = (counter + 1) %
              16; // Ruller gennem de forskellige gesturEvent værdier (0-15)
  }
}
```

## src/BLE_Simulator.h
```c
#ifndef BLE_SIMULATOR_H
#define BLE_SIMULATOR_H


#include <zephyr/types.h>
#include <stddef.h>
#include <errno.h>
#include <zephyr/kernel.h>
#include <zephyr/sys/printk.h>

void BLE_Simulator_ThreadFunct(void *control_q_ptr, void *p2, void *p3);

#endif
```

## src/BLE_central.c
```c
#include "BLE_central.h"
#include "gestureEvent.h"

uint8_t BLE_scan(); 
static struct bt_conn *thinkerbell_conn = NULL;
static bool ready_to_scan = true;

// ------------------ subscribe struktur START ----------------
// kommer her fra
// https://github.com/zephyrproject-rtos/zephyr/blob/main/samples/bluetooth/central_hr/src/main.c#L73
static struct bt_gatt_subscribe_params subscribe_params;
static struct k_msgq *BLE_control_q;

static uint8_t notify(struct bt_conn *conn, struct bt_gatt_subscribe_params *params, const void *data, uint16_t length)
{
    if (data == NULL) {
        printk("unsubscribed\n");
        return BT_GATT_ITER_STOP;
    }

  uint8_t *buf = (uint8_t *)data;
  gestureEvent event = (gestureEvent)buf[0];
  k_msgq_put(BLE_control_q, &event, K_NO_WAIT);

  return BT_GATT_ITER_CONTINUE;
}

// ------------------ subscribe struktur END ----------------

//---------------- discover struktur START ---------------------
// kommer fra
// https://github.com/zephyrproject-rtos/zephyr/blob/main/samples/bluetooth/central_hr/src/main.c

static struct bt_gatt_discover_params discover_params;

static uint8_t discover(struct bt_conn *conn, const struct bt_gatt_attr *attr, struct bt_gatt_discover_params *params)
{
        if (attr == NULL) {
                subscribe_params.notify = notify;
                subscribe_params.value_handle = 52;  
                subscribe_params.ccc_handle = 53;    
                subscribe_params.value = BT_GATT_CCC_NOTIFY;
                bt_gatt_subscribe(conn, &subscribe_params);
                printk("Discovery færdig, subscribing\n");
                return BT_GATT_ITER_STOP;
        }

        return BT_GATT_ITER_CONTINUE;
}

//---------------- discover struktur END ---------------------

//-------- connect/disconnect struktur START----------------
// kommer fra
// https://github.com/zephyrproject-rtos/zephyr/blob/main/samples/bluetooth/central/src/main.c

static void connected(struct bt_conn *conn, uint8_t err) {
  if (err) {
    printk("Forbindelse fejlede, err: %d\n", err);
    if (thinkerbell_conn != NULL) {
      bt_conn_unref(thinkerbell_conn);
    }
    bt_le_scan_stop(); // stopper scan
    thinkerbell_conn = NULL;

    ready_to_scan = true;

    return;
  }
  thinkerbell_conn = conn;  

  printk("Forbundet til Thinkerbell!\n");

  // discovery parameter sættes her
  discover_params.uuid = NULL; // default for at finde alt
  discover_params.func = discover;
  discover_params.start_handle = BT_ATT_FIRST_ATTRIBUTE_HANDLE; // alle atributter er en handle søgning, her starter vi bare fra den første af
  discover_params.end_handle = BT_ATT_LAST_ATTRIBUTE_HANDLE; // og den skal søge op til maks mulige handles

  discover_params.type = BT_GATT_DISCOVER_ATTRIBUTE; 
  bt_gatt_discover(conn, &discover_params);
}

static void disconnected(struct bt_conn *conn, uint8_t reason) {

  printk("Forbindelse afbrudt, reason: %d\n", reason);

  if (thinkerbell_conn != conn) {
    return;
  }
  bt_conn_unref(thinkerbell_conn);

  thinkerbell_conn = NULL;
  ready_to_scan = true;
}

BT_CONN_CB_DEFINE(conn_callbacks) = {
    .connected = connected,
    .disconnected = disconnected,
};
//-------- connect/disconnect struktur END----------------


//https://docs.zephyrproject.org/latest/doxygen/html/group__bt__gap.html#ga652eef01e5256e0d820cd1f4db877429 søg: bt_data_parse
static bool BLE_check_addr(struct bt_data *data, void *user_data)
{
        const bt_addr_le_t *addr = (const bt_addr_le_t *)user_data;     //skal caste userdata til bt_addr_le_t

        if (data->type == BT_DATA_UUID128_ALL) {                //TYPE: UUID128


        const uint8_t uuid[] = {                                //Det UUID som er sat på Photon
                0xab, 0x90, 0x78, 0x56, 0x34, 0x12, 0x34, 0x12,
                0x34, 0x12, 0x34, 0x12, 0x78, 0x56, 0x34, 0x12
        };

        if (memcmp(data->data, uuid, 16) == 0) {
                printk("Thinkerbell fundet!\n");
                //connect
                bt_le_scan_stop();              //stopper sacn
                //https://docs.zephyrproject.org/latest/doxygen/html/group__bt__conn.html#ga8d66f3e0262a51279e9fa8b3139252e6  søg: bt_conn_le_create
                bt_conn_le_create(addr, BT_CONN_LE_CREATE_CONN, BT_LE_CONN_PARAM_DEFAULT, &thinkerbell_conn);        //default
                return false;
                }
        }
  
        return true;
}

//callback bt_le_scan_cb_t
//https://docs.zephyrproject.org/latest/doxygen/html/group__bt__gap.html#ga1c53d22b6e2dee38c825c58f3eeee9b4 søg: bt_le_scan_cb_t
static void BLE_find_photon(const bt_addr_le_t *addr, int8_t rssi, uint8_t adv_type, struct net_buf_simple *buf){
        bt_data_parse(buf, BLE_check_addr, (void *)addr);                       
}

uint8_t BLE_scan() {
  ready_to_scan = false;
  uint8_t err;

  err = bt_le_scan_start(BT_LE_SCAN_ACTIVE, BLE_find_photon);
  if (err) {
    printk("Scanning failed err -  %d\n", err);
    bt_le_scan_stop();
    k_msleep(50);
    ready_to_scan = true;
    return err;
  }
  printk("Scan function started succesfully...\n");
  return 0;
}

uint8_t BLE_init() {

  uint8_t err;

  err = bt_enable(NULL);
  if (err) {
    printk("BLE_INIT failed err - %d\n", err);
    return 0;
  }

  printk("BLE_INIT succes\n");

  return 0;
}

void BLE_ThreadFunct(void *control_q_ptr, void *p2, void *p3) {
  (void)p2;
  (void)p3;
  BLE_control_q = (struct k_msgq *)control_q_ptr;

  BLE_init();

  while (1) {
    if (ready_to_scan) {
      BLE_scan();
    }
    k_msleep(10);
  }
}
```

## src/BLE_central.h
```c
#ifndef BLE_CENTRAL_H
#define BLE_CENTRAL_H


#include <zephyr/types.h>
#include <stddef.h>
#include <errno.h>
#include <zephyr/kernel.h>
#include <zephyr/sys/printk.h>

#include <zephyr/bluetooth/bluetooth.h>
#include <zephyr/bluetooth/hci.h>
#include <zephyr/bluetooth/conn.h>
#include <zephyr/bluetooth/uuid.h>
#include <zephyr/bluetooth/gatt.h>
#include <zephyr/sys/byteorder.h>


void BLE_ThreadFunct(void *control_q_ptr, void *p2, void *p3);


#endif
```

## src/control.c
```c
#include "control.h"
#include <zephyr/kernel.h>

gestureSetting gestureSettings[8] = {
    0}; // Array to hold settings for 8 gestures
int prev_gesture = 4;

int Control_init(void) {
  // Initialize control-related resources (none needed for now)
  return 0; // Return 0 on success
}

midiEvent createMidiEventFromGestureEvent(int gesture_event) {
  midiEvent event;
  event.type = gestureSettings[gesture_event].type;
  event.channel = gestureSettings[gesture_event].channel;
  if (event.type == ControlChange) {
    event.data1 = gestureSettings[gesture_event].controllerNr;
    event.data2 = gestureSettings[gesture_event].value;
  } else if (event.type == NoteOn || event.type == NoteOff) {
    event.data1 = gestureSettings[gesture_event].noteNr;
    event.data2 = gestureSettings[gesture_event].velocity;
  } else {
    event.data1 = gestureSettings[gesture_event].value;
    event.data2 = 0; // Assuming value is stored in data1
  }
  if (gesture_event == 4) { // 'Other' gesture skal ikke sende midi.
    event.channel = 17;     // set ulovlig channel for at ignorere i midiTx.
  }
  // Special handling for continuous gestures (5, 6 og 7) ved 'step out of'
  if ((prev_gesture == 5 && gesture_event != 5) ||
      (prev_gesture == 6 && gesture_event != 6) ||
      (prev_gesture == 7 && gesture_event != 7)) {
    event.channel = gestureSettings[prev_gesture].channel; // behold samme kanal
    event.type =
        gestureSettings[prev_gesture].type; // behold samme midi-besked-type
    if (event.type == ControlChange) {
      event.data1 = gestureSettings[prev_gesture].controllerNr;
      event.data2 =
          0; // Set value to 0 to indicate "off" for the control change
    }
    if (event.type == NoteOn) {
      event.data1 = gestureSettings[prev_gesture].noteNr;
      event.data2 = 0; // Set velocity to 0 to indicate "off" for the note
    }
  }
  prev_gesture = gesture_event;
  // For testing: static output c-note
  /*event.channel = 1;
  event.type = NoteOn;
  event.data1 = 60;
  event.data2 = 100;*/

  return event;
}

void gesture_setting_default(gestureSetting *setting) {
  setting->channel = 1;
  setting->value = 0;
  setting->controllerNr = 0;
  setting->noteNr = 60;
  setting->velocity = 100;
  setting->type = NoteOn;
}

void ControlThreadFunct(void *midi_q_ptr, void *control_q_ptr, void *p3) {
  for (int i = 0; i < 8; i++) {
    gesture_setting_default(&gestureSettings[i]);
  };
  (void)p3;
  /*
  // definér gestureSettings, debug med toner:
  gestureSettings[0].noteNr = 60; // C4
  gestureSettings[1].noteNr = 60; // D4
  gestureSettings[1].velocity = 0;
  gestureSettings[2].noteNr = 64; // E4
  gestureSettings[3].noteNr = 64; // F4
  gestureSettings[3].velocity = 0;
  gestureSettings[4].noteNr = 67; // G4
  gestureSettings[5].noteNr = 67; // A4
  gestureSettings[5].velocity = 0;
  gestureSettings[6].noteNr = 71; // B4
  gestureSettings[7].noteNr = 71; // C5
  gestureSettings[7].velocity = 0;
  */
  
  // definér gestureSettings, med control change:
  gestureSettings[0].type = ControlChange;
  gestureSettings[0].controllerNr = 20;
  gestureSettings[0].value = 127;
  gestureSettings[1].type = ControlChange;
  gestureSettings[1].controllerNr = 21;
  gestureSettings[1].value = 127;
  gestureSettings[2].type = ControlChange;
  gestureSettings[2].controllerNr = 22;
  gestureSettings[2].value = 127;
  gestureSettings[3].type = ControlChange;
  gestureSettings[3].controllerNr = 23;
  gestureSettings[3].value = 127;
  gestureSettings[5].type = ControlChange;
  gestureSettings[5].controllerNr = 24;
  gestureSettings[5].value = 127;
  gestureSettings[6].type = ControlChange;
  gestureSettings[6].controllerNr = 25;
  gestureSettings[6].value = 127;
  gestureSettings[7].type = ControlChange;
  gestureSettings[7].controllerNr = 26;
  gestureSettings[7].value = 127;


  struct k_msgq *midi_q = (struct k_msgq *)midi_q_ptr;
  struct k_msgq *control_q = (struct k_msgq *)control_q_ptr;

  if (Control_init() != 0) {
    return;
  }
  while (1) {
    gestureEvent gesture;
    k_msgq_get(control_q, &gesture,
               K_FOREVER); // Wait for a gesture event from the control queue

    midiEvent event = createMidiEventFromGestureEvent((int)gesture);

    // dispatch event to midi queue
    k_msgq_put(midi_q, &event, K_NO_WAIT); // Send the MIDI event to the midi_q
  }
}
```

## src/control.h
```c
#ifndef CONTROL_H
#define CONTROL_H

#include "midiEvent.h"
#include "gestureEvent.h"
#include "midiTx.h"

typedef struct{
    uint8_t channel;
    uint8_t value;
    uint8_t controllerNr;
    uint8_t noteNr;
    uint8_t velocity;
    midiMsgType type; 
} gestureSetting;

int Control_init(void);
void ControlThreadFunct(void *p1, void *p2, void *p3);

#endif
```

## src/gestureEvent.h
```c
#ifndef GESTUREEVENT_H
#define GESTUREEVENT_H

typedef enum {
  OneDown = 0,
  OneUp = 1,
  TwoDown = 2,
  TwoUp = 3,
  Other = 4,
  SlowDown = 5,
  SlowUp = 6,
  Vibrato = 7
} gestureEvent;

#endif
```

## src/midiEvent.h
```c
#ifndef MIDIEVENT_H
#define MIDIEVENT_H

#include <stdint.h>

typedef enum {
    NoteOff = 8,
    NoteOn = 9,
    PolyKeyPres = 10,
    ControlChange = 11,
    ProgramChange = 12,
    ChannelPressure = 13,
    PitchBend = 14
} midiMsgType;

typedef struct {
    midiMsgType type; 
	uint8_t channel;
	uint8_t data1;
	uint8_t data2;
} midiEvent;

#endif
```

## src/midiTx.c
```c
#include "midiTx.h"
#include <zephyr/drivers/uart.h>
#include <zephyr/kernel.h>

static const struct device *uart_dev;

int Midi_init(void) {
  uart_dev = DEVICE_DT_GET(DT_NODELABEL(uart1));
  if (!device_is_ready(uart_dev)) {
    printk("UART device not ready\n");
    return -1; // Return -1 if UART device is not ready
  }
  return 0;
}
static void uart_cb(const struct device *dev, struct uart_event *evt,
                    void *user_data) { // Callback funktion for UART events.
                                       // Logger når en transmission er aborted.
  switch (evt->type) {

  case UART_TX_DONE:
    break;

  case UART_TX_ABORTED:
    printk("UART transmission aborted\n");
    break;

  case UART_RX_RDY:
    break;

  case UART_RX_BUF_REQUEST:
    break;

  case UART_RX_BUF_RELEASED:
    break;

  case UART_RX_DISABLED:
    break;

  case UART_RX_STOPPED:
    break;

  default:
    break;
  }
}

void MidiTransmitThreadFunct(void *que_ptr, void *p2, void *p3) {
  // Casting the void pointer to a message queue pointer
  struct k_msgq *midi_q = (struct k_msgq *)que_ptr;
  (void)p2;
  (void)p3;
  k_sleep(K_SECONDS(5)); // Give some time for other threads to initialize
  if (Midi_init() != 0) {
    return;
  }
  printk("UART device for midi: %s\n", uart_dev->name);

  int ret = 0;
  // ret = uart_callback_set(uart_dev, uart_cb,
  //                         NULL); // Set the UART callback function
  if (ret) {
    printk("Failed to set UART callback: %d\n", ret);
    return;
  }

  while (1) {
    // Debugging: Send en test MIDI Note On besked hvert sekund med polling
    // midi:
    /*
        while (1) {
          printk("UART ready: %d\n", device_is_ready(uart_dev));
          uart_poll_out(uart_dev, 0x90);
          uart_poll_out(uart_dev, 60);
          uart_poll_out(uart_dev, 127);
          printk("Test MIDI Note On sent\n");
          k_sleep(K_SECONDS(1));
        }
    */
    midiEvent event;
    ret = k_msgq_get(midi_q, &event,
                     K_FOREVER); // polling the queue for a midiEvent, returns 0
                                 // if an event was received
    if (ret == 0) {              // on received midiEvent
      static uint8_t midi_msg[3];
      if (event.channel < 1 || event.channel > 16) {
        printk("Invalid MIDI channel: %d, gesture: other\n", event.channel);
        continue;
      }
      if (event.data1 > 127 || event.data2 > 127) {
        printk("Data bytes must be in the range 0-127\n");
        continue;
      }
      if (event.type == ControlChange && event.data1 > 119) {
        printk("Control Change controller number must be in the range 0-119\n");
        continue;
      }
      midi_msg[0] = (event.type << 4) |
                    ((event.channel - 1) & 0x0F); // Combine type and channel
      midi_msg[1] = event.data1;
      midi_msg[2] = event.data2;
      // transmission
      if (event.type == ProgramChange ||
          event.type == ChannelPressure) { // Program Change og Channel Pressure
                                           // messages har kun én databyte
        static uint8_t short_msg[2];
        for (int i = 0; i < 2; i++) {
          short_msg[i] = midi_msg[i];
          // uart_poll_out(uart_dev, midi_msg[i]);
        }
        int ret = uart_tx(uart_dev, short_msg, 2, SYS_FOREVER_US);
        int counter = 0;
        while (ret == -EBUSY) { // Hvis UART er optaget, vent og prøv igen
          counter++;
          k_sleep(K_MSEC(5)); // Vent 5 ms før næste forsøg
          ret = uart_tx(uart_dev, short_msg, 2, SYS_FOREVER_US);
          if (counter > 5) { // Hvis det stadig er optaget efter 5 forsøg, log
                             // og drop beskeden
            printk("UART busy after multiple attempts, dropping MIDI event\n");
            break;
          }
        }
      } else {
        int ret = uart_tx(
            uart_dev, midi_msg, 3,
            SYS_FOREVER_US); // Attempt to transmit MIDI message without waiting
        int counter = 0;
        if (ret < 0) {
          printk("uart_tx returned %d\n", ret);
        }

        while (ret == -EBUSY) {
          counter++;
          k_sleep(K_MSEC(5));

          ret = uart_tx(uart_dev, midi_msg, 3, SYS_FOREVER_US);

          printk("uart_tx retry %d returned %d\n", counter, ret);

          if (counter > 5) {
            printk("UART busy after multiple attempts\n");
            break;
          }
        }

        /*        while (ret == -EBUSY) { // Hvis UART er optaget, vent og prøv
           igen counter++; k_sleep(K_MSEC(5)); // Vent 5 ms før næste forsøg ret
           = uart_tx(uart_dev, midi_msg, 3, SYS_FOREVER_US); if (counter > 5) {
           // Hvis det stadig er optaget efter 5 forsøg, log
                                     // og drop beskeden
                    printk("UART busy after multiple attempts, dropping MIDI
           event\n"); break;
                  }
                }*/
      }
      printk(
          "MIDI event transmitted: Type=%d, Channel=%d, Data1=%d, Data2=%d\n",
          event.type, event.channel, event.data1, event.data2);
    }
  }
}
```

## src/midiTx.h
```c
#ifndef MIDITX_H
#define MIDITX_H

#include "midiEvent.h"

int Midi_init(void);
void MidiTransmitThreadFunct(void *p1, void *p2, void *p3);

#endif
```
